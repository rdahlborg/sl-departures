## main/Kconfig.projbuild
```kconfig
menu "SL Departures Configuration"
    config APP_AUTHOR
        string "Author shown on the start and about screens and web pages"
        default "Robert Dahlborg"
    config WIFI_SSID
        string "Wi-Fi SSID"
        default ""
        help
            Optional, for developer builds. Used only when no network has
            been saved through the web installer (Improv).
    config WIFI_PASSWORD
        string "Wi-Fi password"
        default ""
    config CLOCK_TZ
        string "POSIX timezone"
        default "CET-1CEST,M3.5.0,M10.5.0/3"
        help
            Europe/Stockholm. SL's API returns local times, so this must match.
    config SL_POLL_SECONDS
        int "Seconds between polls of home and the nearest stations"
        default 30
        range 10 300
        help
            Stations further out are polled at most every 30 seconds. With
            no departures from home within the hour, only home is polled,
            every 5 minutes.
    config INSTALLER_URL
        string "Web installer address shown when Wi-Fi is not set up"
        default "rdahlborg.github.io/sl-departures"
    config OTA_GITHUB_REPO
        string "GitHub repository for firmware updates"
        default "rdahlborg/sl-departures"
        help
            Updates come from the latest release's sl-departures.bin asset.
    config OTA_AUTO_UPDATE
        bool "Install new releases automatically at night"
        default y
    config DISPLAY_FLIP
        bool "Rotate the display 180 degrees"
        default n
endmenu
```

## sdkconfig.defaults
```kconfig
CONFIG_ESPTOOLPY_FLASHSIZE_8MB=y
CONFIG_PARTITION_TABLE_CUSTOM=y
CONFIG_PARTITION_TABLE_CUSTOM_FILENAME="partitions.csv"
CONFIG_LV_FONT_MONTSERRAT_14=y
CONFIG_DISPLAY_FLIP=y
CONFIG_LV_USE_SNAPSHOT=y
```
